## CMakeLists.txt
```
# SPDX-License-Identifier: Apache-2.0

cmake_minimum_required(VERSION 3.20.0)
find_package(Zephyr REQUIRED HINTS $ENV{ZEPHYR_BASE})
project(ipsp)

if (0)
    target_sources(app PRIVATE
            src/main.c
            )
else()

    file(GLOB quant_lib
            ${PROJECT_SOURCE_DIR}/quant/*.c
            ${PROJECT_SOURCE_DIR}/quant/warpe/*.c
            ${PROJECT_SOURCE_DIR}/quant/deps/*.c
            ${PROJECT_SOURCE_DIR}/quant/deps/extra/*.c
            )

    set (QUANT_INC
            ${PROJECT_SOURCE_DIR}/quant
            ${PROJECT_SOURCE_DIR}/quant/warpe
            ${PROJECT_SOURCE_DIR}/quant/deps
            )

    target_include_directories(app PRIVATE "${QUANT_INC}")
    #set (BUIDFLAG )
    #set (BUIDFLAG1 ) # -D'alloca(x)=(void*)&x')
    #    -std=c11 -Os -fstack-usage -foptimize-strlen -ffast-math)
    #add_compile_options(-std=c11 -Os -fstack-usage -foptimize-strlen -ffast-math "-D'alloca(x)=(void*)&x'")
    add_compile_options(-std=c11 -Os -fstack-usage -foptimize-strlen -Wno-strict-prototypes
            -Wno-sign-compare -Wno-maybe-uninitialized
            -ffast-math -Wno-unknown-pragmas
            -Wno-missing-field-initializers
            -Wno-cast-align "-D'alloca(x)=(void*)&x'")
    target_sources(app PRIVATE
            src/main.c
            src/mini_transaction.c
            ${quant_lib}
            )

    set (DEFINES
            MINIMAL_CIPHERS
            NO_ERR_REASONS
            NO_OOO_0RTT
            NO_MIGRATION
            NO_SRT_MATCHING
            NO_QLOG
            NO_TLS_LOG
            NO_ECN
            RIOT_VERSION
            CONTIKI_NG_LE
            DLEVEL=DBG
            ZEPHYR_TEST
            )
    set_property(DIRECTORY . APPEND PROPERTY COMPILE_DEFINITIONS ${DEFINES})

    #add_compile_definitions( ${BUIDFLAG})
    #add_compile_definitions( ${BUIDFLAG1})
endif ()
```

## prj.conf
```kconfig
CONFIG_MINIMAL_LIBC_MALLOC_ARENA_SIZE=122880
CONFIG_MAIN_STACK_SIZE=4096
CONFIG_SYSTEM_WORKQUEUE_STACK_SIZE=4096
#CONFIG_BT_L2CAP_TX_MTU=600
#https://developer.nordicsemi.com/nRF_Connect_SDK/doc/1.7.1/kconfig/CONFIG_BT_L2CAP_TX_MTU.html

CONFIG_BT_BUF_ACL_RX_SIZE=255
CONFIG_BT_BUF_ACL_TX_SIZE=251
CONFIG_BT_BUF_CMD_TX_SIZE=255

CONFIG_BT_L2CAP_TX_MTU=247

CONFIG_BT=y
CONFIG_BT_DEBUG_LOG=y
CONFIG_BT_SMP=y
CONFIG_BT_PERIPHERAL=y
CONFIG_BT_CENTRAL=y
CONFIG_BT_L2CAP_DYNAMIC_CHANNEL=y
CONFIG_BT_DEVICE_NAME="Test IPSP node"
CONFIG_NETWORKING=y
CONFIG_NET_IPV6=y
CONFIG_NET_IPV4=n
CONFIG_NET_UDP=y
CONFIG_NET_TCP=y
CONFIG_TEST_RANDOM_GENERATOR=y
CONFIG_NET_L2_BT=y
CONFIG_INIT_STACKS=y
CONFIG_NET_PKT_RX_COUNT=10
CONFIG_NET_PKT_TX_COUNT=10
CONFIG_NET_BUF_RX_COUNT=20
CONFIG_NET_BUF_TX_COUNT=20
CONFIG_NET_IF_UNICAST_IPV6_ADDR_COUNT=3
CONFIG_NET_IF_MCAST_IPV6_ADDR_COUNT=4
CONFIG_NET_MAX_CONTEXTS=6

CONFIG_NET_CONFIG_AUTO_INIT=y
CONFIG_NET_CONFIG_SETTINGS=y
#CONFIG_NET_CONFIG_MY_IPV6_ADDR="2001:db8::1"
CONFIG_NET_CONFIG_MY_IPV6_ADDR="fd00:a::1"
CONFIG_NET_CONFIG_PEER_IPV6_ADDR="fd00:a::2"
CONFIG_NET_CONFIG_BT_NODE=y
```

## prj_dbg.conf
```kconfig
CONFIG_MINIMAL_LIBC_MALLOC_ARENA_SIZE=122880

CONFIG_BT=y
CONFIG_BT_DEBUG_LOG=y
CONFIG_BT_SMP=y
CONFIG_BT_PERIPHERAL=y
CONFIG_BT_CENTRAL=y
CONFIG_BT_L2CAP_DYNAMIC_CHANNEL=y
CONFIG_BT_DEVICE_NAME="Test IPSP node"
CONFIG_NETWORKING=y
CONFIG_NET_IPV6=y
CONFIG_NET_IPV4=n
CONFIG_NET_UDP=y
CONFIG_NET_TCP=y
CONFIG_TEST_RANDOM_GENERATOR=y
CONFIG_NET_LOG=y
CONFIG_NET_L2_BT=y
CONFIG_INIT_STACKS=y
CONFIG_NET_STATISTICS=y
CONFIG_NET_PKT_RX_COUNT=10
CONFIG_NET_PKT_TX_COUNT=10
CONFIG_NET_BUF_RX_COUNT=20
CONFIG_NET_BUF_TX_COUNT=20
CONFIG_NET_IF_UNICAST_IPV6_ADDR_COUNT=3
CONFIG_NET_IF_MCAST_IPV6_ADDR_COUNT=4
CONFIG_NET_MAX_CONTEXTS=6

CONFIG_NET_CONFIG_AUTO_INIT=y
CONFIG_NET_CONFIG_SETTINGS=y
#CONFIG_NET_CONFIG_MY_IPV6_ADDR="2001:db8::1"
CONFIG_NET_CONFIG_MY_IPV6_ADDR="fd00:a::1"
CONFIG_NET_CONFIG_PEER_IPV6_ADDR="fd00:a::2"
CONFIG_NET_CONFIG_BT_NODE=y
```

## src/main.c
```c
/* main.c - Application main entry point */

/*
 * Copyright (c) 2015-2016 Intel Corporation
 *
 * SPDX-License-Identifier: Apache-2.0
 */

#include <logging/log.h>

#define LOG_LEVEL CONFIG_LOG_DEFAULT_LEVEL
LOG_MODULE_REGISTER(ipsp);

/* Preventing log module registration in net_core.h */
#define NET_LOG_ENABLED	0

#include "../../../../subsys/net/ip/icmpv6.h"

#include <errno.h>
#include <stdio.h>

#include <kernel.h>
#include <linker/sections.h>
#include <net/net_context.h>
#include <net/net_core.h>
#include <net/net_if.h>
#include <net/net_pkt.h>
#include <net/udp.h>
#ifdef ZEPHYR_TEST
#include "quant.h"
#endif

/* Define my IP address where to expect messages */
#define MY_IP6ADDR { { { 0x20, 0x01, 0x0d, 0xb8, 0, 0, 0, 0, \
			 0, 0, 0, 0, 0, 0, 0, 0x1 } } }
#define MY_PREFIX_LEN 64
struct sockaddr  myAddr;
extern  struct qmcon tranx_conn;
static struct in6_addr in6addr_my = MY_IP6ADDR;
extern char *net_sprint_addr(sa_family_t af, const void *addr);
uint8_t udp_connected = 1;
uint32_t syncNewData = 0;
#define MY_PORT 4242
#define SERVER_IPV6_ADDR "2a02:8388:7c7:5400:4194:609e:1042:442a"

#define STACKSIZE 4000
K_THREAD_STACK_DEFINE(thread_stack, STACKSIZE);
static struct k_thread thread_data;

static uint8_t buf_tx[NET_IPV6_MTU];

#define MAX_DBG_PRINT 64

NET_PKT_TX_SLAB_DEFINE(echo_tx_tcp, 15);
NET_PKT_DATA_POOL_DEFINE(echo_data_tcp, 30);

static struct k_mem_slab *tx_tcp_pool(void)
{
	return &echo_tx_tcp;
}

static struct net_buf_pool *data_tcp_pool(void)
{
	return &echo_data_tcp;
}

static struct k_sem quit_lock;
extern struct k_sem waitpkt_lock;

static inline void quit(void)
{
	k_sem_give(&quit_lock);
}

uint8_t per_active = 0;
#define WAIT_TIMEOUT K_SECONDS(1)

enum net_verdict echo_reply_cb(struct net_pkt *pkt,
			       struct net_ipv6_hdr *ip_hdr,
			       struct net_icmp_hdr *icmp_hdr)
{
	LOG_INF("ICMP IPV6 recv from %s to %s", log_strdup(net_sprint_addr(AF_INET6, &ip_hdr->src)),
		log_strdup(net_sprint_addr(AF_INET6, &ip_hdr->dst)) );
	if (icmp_hdr->type == NET_ICMPV6_ECHO_REPLY) {
		LOG_INF("Received Echo Reply\n");
		per_active = 1;
	} else {
		LOG_INF("Received other ICMPv6 message\n");
	}

	return NET_OK;
}
static void is_peer_active(const char *peer)
{

	int ret;
	struct in6_addr dst;

	struct net_icmpv6_handler echo_reply_handler = {
		.type = NET_ICMPV6_ECHO_REPLY,
		.code = 0,
		.handler = echo_reply_cb,
	};

	ret = net_addr_pton(AF_INET6, peer, &dst);

	if (ret < 0) {
		LOG_ERR("Failed to create IPv6 address\n");
		return;
	}

	net_icmpv6_register_handler(&echo_reply_handler);
	uint32_t id = 1;
	uint32_t seq = 1;

	do {
		uint32_t time_stamp = htonl(k_cycle_get_32());
		ret = net_icmpv6_send_echo_request(net_if_get_default(), &dst, id, seq, &time_stamp,
						   sizeof(time_stamp));
		if (ret < 0) {
			LOG_ERR("Failed to send ICMP Echo Request\n");
			//return;
		}

		id++;
		seq++;
		/* Wait for the Echo Reply */
		k_sleep(WAIT_TIMEOUT);
		LOG_WRN("Retry ICMP Echo Request\n");
	} while (per_active == 0);
	LOG_INF("Peer is active resuming normal Udp ipv6 operations\n");
}


static inline void init_app(void)
{
	LOG_INF("Run IPSP sample");

	k_sem_init(&quit_lock, 0, UINT_MAX);

	if (net_addr_pton(AF_INET6,
			  CONFIG_NET_CONFIG_MY_IPV6_ADDR,
			  &in6addr_my) < 0) {
		LOG_ERR("Invalid IPv6 address %s",
			CONFIG_NET_CONFIG_MY_IPV6_ADDR);
	}

	do {
		struct net_if_addr *ifaddr;

		ifaddr = net_if_ipv6_addr_add(net_if_get_default(),
					      &in6addr_my, NET_ADDR_MANUAL, 0);
		LOG_INF("-----------Device Running on IPv6 addr: %s port: %d",
			log_strdup(net_sprint_addr(AF_INET6,(uint8_t *)&ifaddr->address.in6_addr)),
			MY_PORT);
	} while (0);

	// string to ip addr
	net_ipaddr_copy(&net_sin6(&myAddr)->sin6_addr,
			       &in6addr_my);
	net_sin6(&myAddr)->sin6_family = AF_INET6;
	net_sin6(&myAddr)->sin6_port = htons(MY_PORT); // default server port

}

static inline bool get_context(struct net_context **udp_recv6,
			       struct net_context **tcp_recv6)
{
	int ret;
	struct sockaddr_in6 my_addr6 = { 0 };

	my_addr6.sin6_family = AF_INET6;
	my_addr6.sin6_port = htons(MY_PORT);

	ret = net_context_get(AF_INET6, SOCK_DGRAM, IPPROTO_UDP, udp_recv6);
	if (ret < 0) {
		LOG_ERR("Cannot get network context for IPv6 UDP (%d)", ret);
		return false;
	}

	ret = net_context_bind(*udp_recv6, (struct sockaddr *)&my_addr6,
			       sizeof(struct sockaddr_in6));
	if (ret < 0) {
		LOG_ERR("Cannot bind IPv6 UDP port %d (%d)",
			ntohs(my_addr6.sin6_port), ret);
		return false;
	}

	ret = net_context_get(AF_INET6, SOCK_STREAM, IPPROTO_TCP, tcp_recv6);
	if (ret < 0) {
		LOG_ERR("Cannot get network context for IPv6 TCP (%d)", ret);
		return false;
	}

	net_context_setup_pools(*tcp_recv6, tx_tcp_pool, data_tcp_pool);

	ret = net_context_bind(*tcp_recv6, (struct sockaddr *)&my_addr6,
			       sizeof(struct sockaddr_in6));
	if (ret < 0) {
		LOG_ERR("Cannot bind IPv6 TCP port %d (%d)",
			ntohs(my_addr6.sin6_port), ret);
		return false;
	}

	ret = net_context_listen(*tcp_recv6, 0);
	if (ret < 0) {
		LOG_ERR("Cannot listen IPv6 TCP (%d)", ret);
		return false;
	}


	return true;
}

static int build_reply(const char *name,
		       struct net_pkt *pkt,
		       uint8_t *buf)
{
	int reply_len = net_pkt_remaining_data(pkt);
	int ret;
	LOG_INF("-------------Build UDP reply");

	LOG_INF("%s received %d bytes", log_strdup(name), reply_len);

	ret = net_pkt_read(pkt, buf, reply_len);
	if (ret < 0) {
		LOG_ERR("cannot read packet: %d", ret);
		return ret;
	}

	LOG_DBG("sending %d bytes", reply_len);

	return reply_len;
}

static inline void pkt_sent(struct net_context *context,
			    int status,
			    void *user_data)
{
	if (status >= 0) {
		LOG_DBG("Sent %d bytes", status);
	}
}

static inline void set_dst_addr(sa_family_t family,
				struct net_pkt *pkt,
				struct net_ipv6_hdr *ipv6_hdr,
				struct net_udp_hdr *udp_hdr,
				struct sockaddr *dst_addr)
{
	net_ipaddr_copy(&net_sin6(dst_addr)->sin6_addr,
			&ipv6_hdr->src);
	net_sin6(dst_addr)->sin6_family = AF_INET6;
	net_sin6(dst_addr)->sin6_port = udp_hdr->src_port;
}

#ifdef ZEPHYR_TEST
static void quic_recv(struct net_context *context,
		      struct net_pkt *pkt,
		      union net_ip_header *ip_hdr,
		      union net_proto_header *proto_hdr,
		      int status,
		      void *user_data)
{
	// prepare data for the quick socket receive to pull all pkt details and buffer.
	//tranx_conn.w->u6_rec->src_port = proto_hdr->udp->src_port;
	net_ipaddr_copy(&net_sin6(&tranx_conn.w->u6_rec.src_addr)->sin6_addr, &ip_hdr->ipv6->src);
	net_sin6(&tranx_conn.w->u6_rec.src_addr)->sin6_family = AF_INET6;
	net_sin6(&tranx_conn.w->u6_rec.src_addr)->sin6_port = proto_hdr->udp->src_port;
	tranx_conn.w->u6_rec.pkt = pkt;
	tranx_conn.w->u6_rec.user_data = user_data;

	LOG_INF("recv UDP pkt ready for processing ");
	//signal to the receiver end of quic to fast pull the udp pkt
	syncNewData += 1;
	k_sem_give(&waitpkt_lock);
}
#endif

static void udp_received(struct net_context *context,
			 struct net_pkt *pkt,
			 union net_ip_header *ip_hdr,
			 union net_proto_header *proto_hdr,
			 int status,
			 void *user_data)
{
	struct sockaddr dst_addr;
	sa_family_t family = net_pkt_family(pkt);
	static char dbg[MAX_DBG_PRINT + 1];
	int ret;
	LOG_INF("-------------Incoming UDP");

	snprintf(dbg, MAX_DBG_PRINT, "UDP IPv%c",
		 family == AF_INET6 ? '6' : '4');


	set_dst_addr(family, pkt, ip_hdr->ipv6, proto_hdr->udp, &dst_addr);

	ret = build_reply(dbg, pkt, buf_tx); // pkt buffer
	if (ret < 0) {
		LOG_ERR("Cannot send data to peer (%d)", ret);
		return;
	}

	net_pkt_unref(pkt);

	ret = net_context_sendto(context, buf_tx, ret, &dst_addr,
				 family == AF_INET6 ?
						    sizeof(struct sockaddr_in6) :
						    sizeof(struct sockaddr_in),
				 pkt_sent, K_NO_WAIT, dbg);
	LOG_INF("-------------sent UDP ret: %d dest: %s port: %d",
		ret, log_strdup(net_sprint_addr(AF_INET6,(uint8_t *)&net_sin6(&dst_addr)->sin6_addr)),
		ntohs(net_sin6(&dst_addr)->sin6_port) );
	if (ret < 0) {
		LOG_ERR("Cannot send data to peer (%d)", ret);
	}
}

static void setup_udp_recv(struct net_context *udp_recv6)
{
	int ret;

#ifdef ZEPHYR_TEST
	ret = net_context_recv(udp_recv6, quic_recv, K_NO_WAIT, NULL);
#else
	ret = net_context_recv(udp_recv6, udp_received, K_NO_WAIT, NULL);
#endif
	if (ret < 0) {
		LOG_ERR("Cannot receive IPv6 UDP packets");
	}
}

static void tcp_received(struct net_context *context,
			 struct net_pkt *pkt,
			 union net_ip_header *ip_hdr,
			 union net_proto_header *proto_hdr,
			 int status,
			 void *user_data)
{
	static char dbg[MAX_DBG_PRINT + 1];
	sa_family_t family;
	int ret, len;

	if (!pkt) {
		/* EOF condition */
		return;
	}

	family = net_pkt_family(pkt);
	len = net_pkt_remaining_data(pkt);

	snprintf(dbg, MAX_DBG_PRINT, "TCP IPv%c",
		 family == AF_INET6 ? '6' : '4');

	ret = build_reply(dbg, pkt, buf_tx);
	if (ret < 0) {
		LOG_ERR("Cannot send data to peer (%d)", ret);
		return;
	}

	(void)net_context_update_recv_wnd(context, len);
	net_pkt_unref(pkt);

	ret = net_context_send(context, buf_tx, ret, pkt_sent,
			       K_NO_WAIT, NULL);
	if (ret < 0) {
		LOG_ERR("Cannot send data to peer (%d)", ret);
		quit();
	}
}

static void tcp_accepted(struct net_context *context,
			 struct sockaddr *addr,
			 socklen_t addrlen,
			 int error,
			 void *user_data)
{
	int ret;

	NET_DBG("Accept called, context %p error %d", context, error);

	net_context_set_accepting(context, false);

	ret = net_context_recv(context, tcp_received, K_NO_WAIT, NULL);
	if (ret < 0) {
		LOG_ERR("Cannot receive TCP packet (family %d)",
			net_context_get_family(context));
	}
}

static void setup_tcp_accept(struct net_context *tcp_recv6)
{
	int ret;

	ret = net_context_accept(tcp_recv6, tcp_accepted, K_NO_WAIT, NULL);
	if (ret < 0) {
		LOG_ERR("Cannot receive IPv6 TCP packets (%d)", ret);
	}
}

static void listen(void)
{
	struct net_context *udp_recv6 = { 0 };
	struct net_context *tcp_recv6 = { 0 };
	udp_connected = 1;

	if (!get_context(&udp_recv6, &tcp_recv6)) {
		LOG_ERR("Cannot get network contexts");
		udp_connected = 0;
		return;
	}

	setup_tcp_accept(tcp_recv6);
	setup_udp_recv(udp_recv6);
	LOG_INF("Starting to quic engine udp_connected: %d", udp_connected);
#ifdef ZEPHYR_TEST
	quic_init_Wegine(udp_recv6);
#endif


	//todo: Check if the peer is active
	is_peer_active(SERVER_IPV6_ADDR);
	LOG_INF("Starting QUIC STACK.........");

#ifdef ZEPHYR_TEST
//#define SERVER_IPV6_ADDR "2001:db8::2" //2a02:8388:7c7:5400:4194:609e:1042:442a
	quic_transx("/index.html", SERVER_IPV6_ADDR);

#endif


	k_sem_take(&quit_lock, K_FOREVER);

	LOG_INF("Stopping...");

	net_context_put(udp_recv6);
	net_context_put(tcp_recv6);
}

void main(void)
{
	init_app();

	k_thread_create(&thread_data, thread_stack, STACKSIZE,
			(k_thread_entry_t)listen,
			NULL, NULL, NULL, K_PRIO_COOP(7), 0, K_NO_WAIT);
}
```

## src/mini_transaction.c
```c
//
// Created by Dennis Kwame Addo on 12/20/22.
//


#include <stdbool.h>
#include <stdint.h>
#include <stdio.h>
#include <string.h>
//#include <sys/param.h>
#include "quant.h"


#define LOG_LEVEL CONFIG_LOG_DEFAULT_LEVEL
LOG_MODULE_REGISTER(quic_transx);
#define SERVER_IPV6_ADDR "2001:db8::2"



//PROCESS(quic_etranx, "QUIC Transac");

// XXX: change "flash" to 0 to disable 0-RTT:
static const struct q_conf qc = {0, "flash", 0, 0,
                                 0, 0, 0, 20, false};
struct qmcon tranx_conn;
static struct w_iov_sq o = w_iov_sq_initializer(o);


static inline void pkt_sent(struct net_context *context,
			    int status,
			    void *user_data)
{
	if (status >= 0) {
		LOG_DBG("Sent %d bytes", status);
	}
}

//static struct etimer timer;
#define CLIENT_SEND_INTERVAL      (10 * 1)

void quic_transx(const char * const req, const char* peer )
{

  tranx_conn.peer = peer;//SERVER_IPV6_ADDR;
  tranx_conn.qrcnt = 1;
  tranx_conn.req = req; // "/index.html"
  struct in6_addr in6addr_my;

  if (net_addr_pton(AF_INET6,
		    peer,
		    &in6addr_my) < 0) {
	  LOG_ERR("Invalid IPv6 address %s",
		  CONFIG_NET_CONFIG_MY_IPV6_ADDR);
	  return ;
  }

  net_ipaddr_copy(&net_sin6(&tranx_conn.p_addr)->sin6_addr,
			 &in6addr_my);
  net_sin6(&tranx_conn.p_addr)->sin6_family = AF_INET6;
  net_sin6(&tranx_conn.p_addr)->sin6_port = htons(4432); // default server port

  //start the state machine for the first connection or handshake
  LOG_INF("q_connect: connection /handshake handler init \n");
  q_alloc(tranx_conn.w, &o, 0, AF_INET6, 512); // af family is ipv6
  struct w_iov * const v = sq_first(&o);
  v->len = sprintf((char *)v->buf, "GET %s\r\n", tranx_conn.req);
#if 0
  ///############### testing
  static uint8_t buf_tx[NET_IPV6_MTU + 20];
  //snprintf(buf_tx, v->len,"%s",v->buf);
  memset(buf_tx,45, 250);
  int ret = net_context_sendto(tranx_conn.w->u6_rec.cntx, buf_tx, 200 , &tranx_conn.p_addr,
			       sizeof(struct sockaddr_in6) ,
			       pkt_sent, K_NO_WAIT, buf_tx);
  if (ret < 0) {
	  LOG_ERR("Cannot send data to peer (%d)", ret);
  }

  do{
	  k_sleep(K_SECONDS(70));
  } while (1);
#endif

  static const struct q_conn_conf qcc = {
      60, 0, 0, 0, 0,
      0, 0, 0, 0,
      0, 0xff000000 + DRAFT_VERSION};
  LOG_INF("quic_etranx:  new transaction \n");
  tranx_conn.c  = q_connect(tranx_conn.w, &tranx_conn.p_addr, tranx_conn.peer,
                           &o, &tranx_conn.s, true,
                           "hq-" DRAFT_VERSION_STRING, &qcc);

//do{
//	k_sleep(K_SECONDS(70));
//} while (1);

  uint16_t cnt = 0;
  while (1)
  {

	  if (tranx_conn.c) {
		  LOG_INF("======Get Response==========");
		  struct w_iov_sq i = w_iov_sq_initializer(i);
		  q_read_stream(tranx_conn.s, &i, true);
		  const uint16_t len = w_iov_sq_len(&i);
		  LOG_INF("retrieved %" PRIu32 " bytes", len);
		  struct w_iov *const sv = sq_first(&i);
		  LOG_INF("----------Payload %d bytes->\n%s", sv->len, sv->buf);

		  LOG_INF("=====Get Done=======");
		  q_free(&i);
		  q_free_stream(tranx_conn.s);
		  if(cnt > 1)
			  break ;

		  LOG_INF("====Free Done========");
		  //sleep(4); // sleep for some time before new request

		  //todo: here we sent a fresh new request, Using old connection but new stream
		  LOG_INF("==============New Stream Pointer ================================");
		  tranx_conn.s = q_rsv_stream(tranx_conn.c, true); // request a new stream
		  LOG_INF("=====New Stream Pointer Done ===================");
		  q_alloc(tranx_conn.w, &o, 0, AF_INET6, 512); // allocate memory for the stream
		  struct w_iov * const vv = sq_first(&o);
		  vv->len = sprintf((char *)vv->buf, "GET %s\r\n", tranx_conn.req);
		  q_write(tranx_conn.s, &o, true); // send new request on the same stream 0

		  cnt += 1;

	  } else {
		  LOG_ERR( "could not retrieve %s", v->buf);
		  cnt += 1;
		  break ;
	  }
  }
  LOG_INF("====Con Closed ========");
  q_free(&o);
  q_close(tranx_conn.c, 0, "No connection");

  q_cleanup(tranx_conn.w);

}
#if 0
PROCESS_THREAD(quic_etranx, ev, data)
{
  PROCESS_BEGIN();
  LOG_INFO("  QUIC Transx Started  \n");

  do {
    etimer_set(&timer, 2);
    PROCESS_WAIT_EVENT_UNTIL(etimer_expired(&timer));
    LOG_INFO("  QUIC wait \n");
  } while(!quic_udp_active());

  etimer_set(&timer, 1);

  while(1) {
    PROCESS_YIELD();
    if((ev == PROCESS_EVENT_TIMER) && (data == &timer)) {
      etimer_set(&timer, CLIENT_SEND_INTERVAL);
    }
    static uint8_t qwait = 0;


    if (tranx_conn.c == NULL) { // connection /handshake handler
      LOG_INFO("q_connect: connection /handshake handler init \n");
      q_alloc(tranx_conn.w, &o, 0, AF_INT6, 512); // af family is ipv6
      struct w_iov * const v = sq_first(&o);
      v->len = sprintf((char *)v->buf, "GET %s\r\n", tranx_conn.req);

      static const struct q_conn_conf qcc = {
          30, 0, 0, 0, 0,
          0, 0, 0, 0,
          0, 0xff000000 + DRAFT_VERSION};
      LOG_INFO("quic_etranx:  new transaction \n");
      tranx_conn.c  = q_connect(tranx_conn.w, &tranx_conn.p_addr, tranx_conn.peer,
                               &o, &tranx_conn.s, true,
                    "hq-" DRAFT_VERSION_STRING, &qcc);

      qwait = 1; // wait for response
    }

    if (tranx_conn.c ) { // streams handler
      if(qwait) {
        warn(DBG, "==============Get Response================================");
        struct w_iov_sq i = w_iov_sq_initializer(i);
        q_read_stream(tranx_conn.s, &i, true);
        const uint16_t len = w_iov_sq_len(&i);
        warn(DBG, "retrieved %" PRIu32 " bytes", len);
        struct w_iov *const sv = sq_first(&i);
        tranx_conn.qrcnt = 0;
        tranx_conn.cl_callback(&sv->saddr, sv->buf, sv->len);
        // warn(DBG, "Payload %d bytes->\n%s", sv->len, sv->buf);

        warn(DBG, "==============Get Done================================");
        qwait = 0;
        q_free(&i);
        q_free_stream(tranx_conn.s);
      }

      if(tranx_conn.qrcnt) {
        // todo: here we sent a fresh new request, Using old connection but new stream
        tranx_conn.s = q_rsv_stream(tranx_conn.c, true); // request a new stream
        q_alloc(tranx_conn.w, &o, 0, AF_INT6,
                512); // allocate memory for the stream
        struct w_iov *const vv = sq_first(&o);
        vv->len = sprintf((char *)vv->buf, "GET %s\r\n", tranx_conn.req);
        q_write(tranx_conn.s, &o, true); // send new request on the same stream 0
        qwait = 1; // wait for response
      }


    }
    else {
      struct w_iov * const vb = sq_first(&o);
      warn(DBG, "could not retrieve %s", vb->buf);
    }

    if(tranx_conn.clean) {
      // free the memory here
      q_free(&o);
      q_close(tranx_conn.c, 0, "No connection");
      q_cleanup(tranx_conn.w);
    }

  } /* while (1) */

  PROCESS_END();
}
#endif


void quic_init_Wegine(struct net_context *u6_ctxt)
{
  LOG_INF("q_init: init wengine \n");
  tranx_conn.w = q_init("uIP", &qc);
  tranx_conn.w->u6_rec.cntx = u6_ctxt;

  LOG_INF("quic_etranx:  q_init done and ready for quic conn \n");
  tranx_conn.c = 0;
}
```
